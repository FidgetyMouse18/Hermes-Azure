## CMakeLists.txt
```
# SPDX-License-Identifier: Apache-2.0

cmake_minimum_required(VERSION 3.20.0)
find_package(Zephyr REQUIRED HINTS $ENV{ZEPHYR_BASE})
project(DT3BASE)

FILE(GLOB app_sources src/*.c)

FILE(GLOB scan ../mylib/scan.c)
FILE(GLOB node_list ../mylib/node_list.c)
FILE(GLOB wifi ../mylib/wifi.c)

target_sources(app PRIVATE ${app_sources} ${scan} ${node_list} ${wifi})

target_include_directories(app PRIVATE ../mylib)
```

## prj.conf
```kconfig
CONFIG_SHELL=y
CONFIG_SHELL_STACK_SIZE=4096
CONFIG_HEAP_MEM_POOL_SIZE=8192
CONFIG_MAIN_STACK_SIZE=8192
CONFIG_BT_RX_STACK_SIZE=4096
CONFIG_PRINTK=y
CONFIG_KERNEL_SHELL=y

# CONFIG_LOG=y
# CONFIG_LOG_DEFAULT_LEVEL=4

CONFIG_BT=y
CONFIG_BT_OBSERVER=y

# CONFIG_SETTINGS=y
# CONFIG_BT_SETTINGS=y
# CONFIG_BT_DEVICE_NAME_DYNAMIC=n

CONFIG_CBPRINTF_FP_SUPPORT=y
CONFIG_NEWLIB_LIBC=y
CONFIG_JSON_LIBRARY=y


# --- Networking & Wi-Fi ---
CONFIG_NETWORKING=y
CONFIG_WIFI=y
CONFIG_WIFI_ESWIFI=y               # ISM43362 driver for Disco L475 
CONFIG_NET_L2_WIFI_MGMT=y
CONFIG_NET_IPV4=y
CONFIG_NET_CONFIG_SETTINGS=y
CONFIG_POSIX_API=y
CONFIG_NET_LOG=y
CONFIG_WIFI_ESWIFI_THREAD_PRIO=7
CONFIG_NET_SOCKETS_POLL_MAX=1
CONFIG_NET_TCP_RECV_QUEUE_TIMEOUT=100

CONFIG_NET_SOCKETS=y
CONFIG_NET_TCP=y
CONFIG_NET_CONTEXT_SYNC_RECV=y


# --- Utilities ---
CONFIG_NEWLIB_LIBC=y
CONFIG_LOG=y
CONFIG_PRINTK=y
CONFIG_THREAD_MONITOR=y

# eswifi specific configs
CONFIG_WIFI_ESWIFI_BUS_SPI=y
CONFIG_NET_TX_STACK_SIZE=2048
CONFIG_NET_RX_STACK_SIZE=2048
CONFIG_WIFI_ESWIFI_THREAD_PRIO=5
# CONFIG_MAIN_STACK_SIZE=4096
CONFIG_SYSTEM_WORKQUEUE_STACK_SIZE=4096

# Network buffers
CONFIG_NET_PKT_RX_COUNT=20
CONFIG_NET_PKT_TX_COUNT=10
CONFIG_NET_BUF_RX_COUNT=40
CONFIG_NET_BUF_TX_COUNT=20
CONFIG_NET_MGMT_EVENT_STACK_SIZE=1024
CONFIG_NET_SOCKETS_CONNECT_TIMEOUT=30000
CONFIG_NET_TCP_TIME_WAIT_DELAY=3000
```

## src/main.c
```c
#include "../../mylib/scan.h"
// #include "../../mylib/wifi.h"

int main(void)
{
}
```
